## conf/layer.conf
```bitbake
# Layer version
LAYERVERSION = "1"

# We have a conf and classes directory, append to BBPATH
BBPATH .= ":${LAYERDIR}"

# We have a recipes directory, add to BBFILES
BBFILES += "${LAYERDIR}/recipes*/*/*.bb \
            ${LAYERDIR}/recipes*/*/*.bbappend"

BBFILE_COLLECTIONS += "meta-tano-openwrt-rpi"
BBFILE_PATTERN_meta-tano-openwrt-rpi := "^${LAYERDIR}/"
BBFILE_PRIORITY_meta-tano-openwrt-rpi = "17"

LICENSE_PATH += "${LAYERDIR}/licenses"

LAYERDEPENDS_meta-tano-openwrt-rpi = "\
	tano-openwrt-layer \
	raspberrypi \
	core \
	openembedded-layer \
	networking-layer \
	meta-python \
	multimedia-layer \
"

LAYERSERIES_COMPAT_meta-tano-openwrt-rpi = "warrior"

# Set a variable to get the top of the metadata location
TANOWRT_HW_BASE = '${@os.path.normpath("${LAYERDIR}/")}'
```
